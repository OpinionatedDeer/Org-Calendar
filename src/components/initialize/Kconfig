## src/components/initialize/Kconfig
```kconfig
menu "Initialization Configuration"
config  INIT_PIN_MOSI
	int "MOSI PIN"
	default 18

config INIT_PIN_SCLK
    int "SCLK Pin"
    default 19

config  INIT_PIN_MISO
	int "MISO PIN"
	default 20

endmenu
```

## src/components/m274-encoder/Kconfig
```kconfig
menu "m274 encoder config"


config DEBUG_MODE
	bool "Turn on and off the LOGI"
	default n

config PIN_A
    int "PIN_A"
    default 02

config PIN_B
    int "PIN_B"
    default 01

config PIN_SW
    int "PIN_SW"
    default 00


endmenu
```

## src/components/w25q32-manager/Kconfig
```kconfig
menu "FLASH Configuration"


config DEBUG_MODE
	bool "Turn on and off the LOGI"
	default false

config FLASH_SPI_FREQUENCY
    int "SPI Frequency in MHZ"
    range 1 80
    default 40
    help
        Choose a value between 1-80

config FLASH_CS
    int "CS Pin"
    default 21

config FLASH_SIZE
	int "Flash Size in MB"
	range 1 32
	default 4
config FORMAT_PARTITION
	bool "Format Partition on next boot"
	default false

endmenu
```
